/* Copyright (c) 2013-2014, The Linux Foundation. All rights reserved.
 *
 * This program is free software; you can redistribute it and/or modify
 * it under the terms of the GNU General Public License version 2 and
 * only version 2 as published by the Free Software Foundation.
 *
 * This program is distributed in the hope that it will be useful,
 * but WITHOUT ANY WARRANTY; without even the implied warranty of
 * MERCHANTABILITY or FITNESS FOR A PARTICULAR PURPOSE.  See the
 * GNU General Public License for more details.
 */

&mdss_mdp {
	dsi_r63419_sharp_wqhd_cmd_1: qcom,dsi_r63419_sharp_wqhd_cmd_1 {
		qcom,mdss-dsi-panel-name = "dsi_r63419_sharp_wqhd_cmd_1 cmd mode dsi panel";
		qcom,cont-splash-enabled;
		qcom,mdss-dsi-panel-controller = <&mdss_dsi1>;
		//qcom,mdss-dsi-panel-type = "dsi_video_mode";
		qcom,mdss-dsi-panel-type = "dsi_cmd_mode"; //for cmd mode
		qcom,mdss-dsi-panel-destination = "display_2";
		qcom,mdss-dsi-panel-framerate = <60>;
		qcom,mdss-dsi-virtual-channel-id = <0>;
		qcom,mdss-dsi-stream = <0>;
		qcom,mdss-dsi-panel-width = <720>;
		qcom,mdss-dsi-panel-height = <2560>;
		qcom,mdss-dsi-h-front-porch = <100>;
		qcom,mdss-dsi-h-back-porch = <30>;
		qcom,mdss-dsi-h-pulse-width = <16>;
		qcom,mdss-dsi-h-sync-skew = <0>;
		qcom,mdss-dsi-v-back-porch = <3>;
		qcom,mdss-dsi-v-front-porch = <4>;
		qcom,mdss-dsi-v-pulse-width = <1>;
		//qcom,mdss-dsi-h-left-border = <0>;
		//qcom,mdss-dsi-h-right-border = <0>;
		//qcom,mdss-dsi-v-top-border = <0>;
		//qcom,mdss-dsi-v-bottom-border = <0>;
		qcom,mdss-dsi-bpp = <24>;
		qcom,mdss-dsi-underflow-color = <0xff>;
		qcom,mdss-dsi-border-color = <0>;

		qcom,mdss-dsi-te-pin-select = <1>;
		qcom,mdss-dsi-wr-mem-start = <0x2c>;
		qcom,mdss-dsi-wr-mem-continue = <0x3c>;
		qcom,mdss-dsi-te-dcs-command = <1>;
		qcom,mdss-dsi-te-check-enable;
		qcom,mdss-dsi-te-using-te-pin;
		//qcom,dcs-cmd-by-left;
		
		qcom,mdss-dsi-on-command = [
		#if 0
		29 01 00 00 00 00 02 B0 00	//unlock
            		29 01 00 00 00 00 02 D6 01	//remove nvm reload after sleep out
            		29 01 00 00 00 00 02 B3 08		//18:video,08:cmd		
            		39 01 00 00 00 00 02 51 00		//brightness
            		39 01 00 00 00 00 02 53 2C //0C		//PWM output enable,dimming function on
            		39 01 00 00 00 00 02 55 00
            		39 01 00 00 00 00 02 35 00		//TE enable
            		39 01 00 00 00 00 05 2A 00 00 05 9F		//colume for cmd mode
            		//29 01 00 00 00 00 02 B0 03		//lock,remove it for CE

            		39 01 00 00 12 00 02 29 00		
            		39 01 00 00 78 00 02 11 00
        #endif
            		];
		qcom,mdss-dsi-off-command = [39 01 00 00 02 00 02 28 00
				 39 01 00 00 a0 00 02 10 00];
		qcom,mdss-dsi-on-command-state = "dsi_lp_mode";
		qcom,mdss-dsi-off-command-state = "dsi_hs_mode";
		qcom,mdss-dsi-h-sync-pulse = <0>;
		//qcom,mdss-dsi-traffic-mode = "burst_mode";
		qcom,mdss-dsi-traffic-mode = "non_burst_sync_event";
		qcom,mdss-dsi-bllp-eof-power-mode;
		qcom,mdss-dsi-bllp-power-mode;		
		qcom,mdss-dsi-lane-0-state;
		qcom,mdss-dsi-lane-1-state;
		qcom,mdss-dsi-lane-2-state;
		qcom,mdss-dsi-lane-3-state;
		//qcom,cmd-sync-wait-broadcast;
		//qcom,cmd-sync-wait-trigger;
		//qcom,mdss-dsi-panel-timings = [D5 32 22 00 60 5C 2E 3E 29 03 04 00];
		qcom,mdss-dsi-panel-timings = [F0 32 28 00 60 96 37 44 29 03 04 00]; //ok
		//qcom,mdss-dsi-panel-timings = [D5 32 22 00 60 64 26 3A 29 03 04 00]; //for mipi test failed
		qcom,mdss-dsi-t-clk-post = <0x03>;//<0x04>;
		qcom,mdss-dsi-t-clk-pre = <0x2c>;//<0x1b>;
		qcom,mdss-dsi-bl-min-level = <1>;
		qcom,mdss-dsi-bl-max-level = <255>;
		qcom,mdss-dsi-dma-trigger = "trigger_sw";
		qcom,mdss-dsi-mdp-trigger = "none";
		qcom,mdss-dsi-bl-pmic-control-type = "bl_ctrl_dcs";
		qcom,mdss-dsi-reset-sequence = <1 2>, <0 10>, <1 20>;//120
	};
};
