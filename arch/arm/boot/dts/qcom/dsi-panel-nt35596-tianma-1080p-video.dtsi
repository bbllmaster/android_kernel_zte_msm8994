/* Copyright (c) 2013-2014, The Linux Foundation. All rights reserved.
 *
 * This program is free software; you can redistribute it and/or modify
 * it under the terms of the GNU General Public License version 2 and
 * only version 2 as published by the Free Software Foundation.
 *
 * This program is distributed in the hope that it will be useful,
 * but WITHOUT ANY WARRANTY; without even the implied warranty of
 * MERCHANTABILITY or FITNESS FOR A PARTICULAR PURPOSE.  See the
 * GNU General Public License for more details.
 */

&mdss_mdp {
	dsi_nt35596_tianma_1080_vid: qcom,mdss_dsi_nt35596_tianma_1080p_video {
		qcom,mdss-dsi-panel-name = "mdss_dsi_nt35596_tianma_1080p_video";
		qcom,cont-splash-enabled;
		qcom,mdss-dsi-panel-controller = <&mdss_dsi0>;
		qcom,mdss-dsi-panel-type = "dsi_video_mode";
		qcom,mdss-dsi-panel-destination = "display_1";
		qcom,mdss-dsi-panel-framerate = <60>;
		qcom,mdss-dsi-virtual-channel-id = <0>;
		qcom,mdss-dsi-stream = <0>;
		qcom,mdss-dsi-panel-width = <1080>;
		qcom,mdss-dsi-panel-height = <1920>;
		qcom,mdss-dsi-h-front-porch = <90>;
		qcom,mdss-dsi-h-back-porch = <21>;
		qcom,mdss-dsi-h-pulse-width = <2>;
		qcom,mdss-dsi-h-sync-skew = <0>;
		qcom,mdss-dsi-v-back-porch = <8>;
		qcom,mdss-dsi-v-front-porch = <4>;
		qcom,mdss-dsi-v-pulse-width = <2>;
		qcom,mdss-dsi-h-left-border = <0>;
		qcom,mdss-dsi-h-right-border = <0>;
		qcom,mdss-dsi-v-top-border = <0>;
		qcom,mdss-dsi-v-bottom-border = <0>;
		qcom,mdss-dsi-bpp = <24>;
		qcom,mdss-dsi-underflow-color = <0xff>;
		qcom,mdss-dsi-border-color = <0>;
		qcom,mdss-dsi-on-command = [
					39 01 00 00 00 00 02 ff ee
					39 01 00 00 00 00 02 fb 01
					39 01 00 00 0a 00 02 18 40
					39 01 00 00 14 00 02 18 00
					39 01 00 00 00 00 02 7c 31
					
					39 01 00 00 00 00 02 ff 00
					39 01 00 00 00 00 02 fb 01
					39 01 00 00 00 00 02 35 00

					#if 1
					//modify for noise start
					15 01 00 00 00 00 02 ff 01
					15 01 00 00 00 00 02 fb 01
					15 01 00 00 00 00 02 5C 82
					15 01 00 00 00 00 02 5D 82
					15 01 00 00 00 00 02 5E 02
					15 01 00 00 00 00 02 5F 02

					15 01 00 00 00 00 02 ff 05
					15 01 00 00 00 00 02 fb 01
					15 01 00 00 00 00 02 7A 00
					15 01 00 00 00 00 02 86 1B
					15 01 00 00 00 00 02 87 39
					15 01 00 00 00 00 02 88 1B
					15 01 00 00 00 00 02 89 39
					15 01 00 00 00 00 02 B5 20
					15 01 00 00 00 00 02 8C 01
					//modify for noise end
					#endif
					
					//pwm frequency start
					15 01 00 00 00 00 02 FF 04
					15 01 00 00 00 00 02 FB 01
					15 01 00 00 00 00 02 08 03 //50KHZ
					//pwm frequency end
					
					#if 1 //ce start
	                15 01 00 00 00 00 02 FF 03
	  				15 01 00 00 00 00 02 FB 01
	  				15 01 00 00 00 00 02 00 04
	  				15 01 00 00 00 00 02 01 06
	  				15 01 00 00 00 00 02 02 08
	  				15 01 00 00 00 00 02 03 0C
	  				15 01 00 00 00 00 02 04 10
	  				15 01 00 00 00 00 02 05 16
	  				15 01 00 00 00 00 02 06 18
	  				15 01 00 00 00 00 02 07 1D
	  				15 01 00 00 00 00 02 08 20
	  				15 01 00 00 00 00 02 09 24
	  				15 01 00 00 00 00 02 0A 28
	  				15 01 00 00 00 00 02 0B 2A
	  				15 01 00 00 00 00 02 0C 36
	  				15 01 00 00 00 00 02 0D 44
	  				15 01 00 00 00 00 02 0E 52
	  				15 01 00 00 00 00 02 0F 56
	  				15 01 00 00 00 00 02 10 5A
	  				15 01 00 00 00 00 02 11 5C
	  				15 01 00 00 00 00 02 12 5E
	  				15 01 00 00 00 00 02 13 60

	  				15 01 00 00 00 00 02 1B 04
	  				15 01 00 00 00 00 02 1C 06
	  				15 01 00 00 00 00 02 1D 08
	  				15 01 00 00 00 00 02 1E 0C
	  				15 01 00 00 00 00 02 1F 10
	  				15 01 00 00 00 00 02 20 14
	  				15 01 00 00 00 00 02 21 18
	  				15 01 00 00 00 00 02 22 1D
	  				15 01 00 00 00 00 02 23 24
	  				15 01 00 00 00 00 02 24 26
	  				15 01 00 00 00 00 02 25 28
	  				15 01 00 00 00 00 02 26 2C
	  				15 01 00 00 00 00 02 27 30
	  				15 01 00 00 00 00 02 28 35
	  				15 01 00 00 00 00 02 29 3A
	  				15 01 00 00 00 00 02 2A 3C
	  				15 01 00 00 00 00 02 2B 37
	  				15 01 00 00 00 00 02 2F 2D
	  				15 01 00 00 00 00 02 30 23
	  				15 01 00 00 00 00 02 31 19
	  				
	  				15 01 00 00 00 00 02 32 8B
	  				15 01 00 00 00 00 02 33 8B
	  				15 01 00 00 00 00 02 34 8B
	  				15 01 00 00 00 00 02 35 89
	  				15 01 00 00 00 00 02 36 87
	  				15 01 00 00 00 00 02 37 85
	  				15 01 00 00 00 00 02 38 87
	  				15 01 00 00 00 00 02 39 89
	  				15 01 00 00 00 00 02 3A 8B
	  				15 01 00 00 00 00 02 3B 8F
	  				15 01 00 00 00 00 02 3F 11
	  				15 01 00 00 00 00 02 40 11
	  				15 01 00 00 00 00 02 41 11
	  				15 01 00 00 00 00 02 42 11
	  				15 01 00 00 00 00 02 43 11
	  				15 01 00 00 00 00 02 44 11
	  				15 01 00 00 00 00 02 45 11
	  				15 01 00 00 00 00 02 46 11
	  				15 01 00 00 00 00 02 47 8F
	  				15 01 00 00 00 00 02 48 8B
	  				15 01 00 00 00 00 02 49 89
	  				15 01 00 00 00 00 02 4A 89
	  				15 01 00 00 00 00 02 4B 8B
	  				15 01 00 00 00 00 02 4C 8B
	  				
	  				15 01 00 00 00 00 02 4D 08
	  				15 01 00 00 00 00 02 4E 1E
	  				15 01 00 00 00 00 02 4F 2A
	  				
	  				15 01 00 00 00 00 02 1A 00
	  				15 01 00 00 00 00 02 53 77
	  				15 01 00 00 00 00 02 54 77
	  				15 01 00 00 00 00 02 55 00
	  				15 01 00 00 00 00 02 5B 00
	  				15 01 00 00 00 00 02 63 00	  				
					#endif //ce end

					15 01 00 00 00 00 02 FF 00
					15 01 00 00 00 00 02 FB 01
					39 01 00 00 00 00 02 51 00
            		39 01 00 00 00 00 02 53 00
            		39 01 00 00 00 00 02 55 91
					
					39 01 00 00 00 00 02 d3 0A
					39 01 00 00 00 00 02 d4 04

					39 01 00 00 10 00 02 11 00
            		39 01 00 00 05 00 02 29 00];
		qcom,mdss-dsi-off-command = [05 01 00 00 32 00 02 28 00
					05 01 00 00 78 00 02 10 00];

		#if 1 //ce start
		qcom,mdss-dsi-ce-off-command = [
		39 00 00 00 00 00 02 FF 03
		39 00 00 00 00 00 02 FB 01
		39 00 00 00 00 00 02 FF 00
		39 01 00 00 00 00 02 55 01];
		qcom,mdss-dsi-ce-low-command = [
		39 00 00 00 00 00 02 FF 03
		39 00 00 00 00 00 02 FB 01
		39 00 00 00 00 00 02 FF 00
		39 01 00 00 00 00 02 55 81];
		qcom,mdss-dsi-ce-mid-command = [
		39 00 00 00 00 00 02 FF 03
		39 00 00 00 00 00 02 FB 01
		39 00 00 00 00 00 02 FF 00
		39 01 00 00 00 00 02 55 91];
		qcom,mdss-dsi-ce-high-command = [
		39 00 00 00 00 00 02 FF 03
		39 00 00 00 00 00 02 FB 01
		39 00 00 00 00 00 02 FF 00
		39 01 00 00 00 00 02 55 B1];
		qcom,mdss-dsi-ce-command-state = "dsi_hs_mode";
		#endif
		
		qcom,mdss-dsi-on-command-state = "dsi_lp_mode";
		qcom,mdss-dsi-off-command-state = "dsi_hs_mode";
		qcom,mdss-dsi-h-sync-pulse = <1>;
		qcom,mdss-dsi-traffic-mode = "burst_mode";
		qcom,mdss-dsi-bllp-eof-power-mode;
		qcom,mdss-dsi-bllp-power-mode;
		qcom,mdss-dsi-lane-0-state;
		qcom,mdss-dsi-lane-1-state;
		qcom,mdss-dsi-lane-2-state;
		qcom,mdss-dsi-lane-3-state;
		qcom,mdss-dsi-panel-timings = [DC 34 22 00 62 66 28 38 2B 03 04 00];
		qcom,mdss-dsi-t-clk-post = <0x05>;
		qcom,mdss-dsi-t-clk-pre = <0x29>;
		qcom,mdss-dsi-bl-min-level = <1>;
		qcom,mdss-dsi-bl-max-level = <255>;
		qcom,mdss-dsi-dma-trigger = "trigger_sw";
		qcom,mdss-dsi-mdp-trigger = "none";
		qcom,mdss-dsi-bl-pmic-control-type = "bl_ctrl_dcs";
		qcom,mdss-dsi-reset-sequence = <1 5>, <0 5>, <1 5>, <0 5>, <1 20>;//<1 20>, <0 1>, <1 20>;
		qcom,mdss-dsi-lp11-init; //add lp11_init
		qcom,mdss-dsi-init-delay-us = <100>;
		qcom,mdss-pan-physical-width-dimension = <68>;
		qcom,mdss-pan-physical-height-dimension = <121>;
	};
};
