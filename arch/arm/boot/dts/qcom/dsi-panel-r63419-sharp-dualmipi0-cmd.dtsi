/* Copyright (c) 2013-2014, The Linux Foundation. All rights reserved.
 *
 * This program is free software; you can redistribute it and/or modify
 * it under the terms of the GNU General Public License version 2 and
 * only version 2 as published by the Free Software Foundation.
 *
 * This program is distributed in the hope that it will be useful,
 * but WITHOUT ANY WARRANTY; without even the implied warranty of
 * MERCHANTABILITY or FITNESS FOR A PARTICULAR PURPOSE.  See the
 * GNU General Public License for more details.
 */

&mdss_mdp {
	dsi_r63419_sharp_wqhd_cmd_0: qcom,dsi_r63419_sharp_wqhd_cmd_0 {
		qcom,mdss-dsi-panel-name = "dsi_r63419_sharp_wqhd_cmd_0 cmd mode dsi panel";
		qcom,cont-splash-enabled;
		qcom,mdss-dsi-panel-controller = <&mdss_dsi0>;
		//qcom,mdss-dsi-panel-type = "dsi_video_mode";
		qcom,mdss-dsi-panel-type = "dsi_cmd_mode"; //for cmd mode
		qcom,mdss-dsi-panel-destination = "display_1";
		qcom,mdss-dsi-panel-framerate = <60>;
		qcom,mdss-dsi-virtual-channel-id = <0>;
		qcom,mdss-dsi-stream = <0>;
		qcom,mdss-dsi-panel-width = <720>;
		qcom,mdss-dsi-panel-height = <2560>;
		qcom,mdss-dsi-h-front-porch = <100>;
		qcom,mdss-dsi-h-back-porch = <30>;
		qcom,mdss-dsi-h-pulse-width = <16>;
		qcom,mdss-dsi-h-sync-skew = <0>;
		qcom,mdss-dsi-v-back-porch = <3>;
		qcom,mdss-dsi-v-front-porch = <4>;
		qcom,mdss-dsi-v-pulse-width = <1>;
		//qcom,mdss-dsi-h-left-border = <0>;
		//qcom,mdss-dsi-h-right-border = <0>;
		//qcom,mdss-dsi-v-top-border = <0>;
		//qcom,mdss-dsi-v-bottom-border = <0>;
		qcom,mdss-dsi-bpp = <24>;
		qcom,mdss-dsi-underflow-color = <0xff>;
		qcom,mdss-dsi-border-color = <0>;

		qcom,mdss-dsi-te-pin-select = <1>;
		qcom,mdss-dsi-wr-mem-start = <0x2c>;
		qcom,mdss-dsi-wr-mem-continue = <0x3c>;
		qcom,mdss-dsi-te-dcs-command = <1>;
		qcom,mdss-dsi-te-check-enable;
		qcom,mdss-dsi-te-using-te-pin;
		
		qcom,mdss-dsi-on-command = [29 01 00 00 00 00 02 B0 04	//unlock
					29 01 00 00 00 00 0A f4 b3 ff 85 85 7d 01 19 19 00 //pull down VCOM
            		29 01 00 00 00 00 02 D6 01	//remove nvm reload after sleep out

					//for display split issue when open cabc begin
					#if 1
            		29 01 00 00 00 00 08 B8 57 3D 23 0F 23 50 50
            		29 01 00 00 00 00 08 B9 6F 3D 28 19 25 c8 c8 
            		29 01 00 00 00 00 08 BA B5 33 41 20 2B A0 A0
            		29 01 00 00 00 00 1A CE 55 40 43
						              49 55 62 71
                                      82 94 A8 B9
                                      CB DB E9 F5
                                      FC FF 01 00 //04:22KHZ default,0A:10KHZ, 01:55KHZ
                                      02 02 46 04 //dimming default(04 04 00 00) 02 02 46 04
                                      00 00
                    #endif
                    //for display split issue when open cabc end
    
            		29 01 00 00 00 00 02 B3 08		//18:video,08:cmd		
            		39 01 00 00 00 00 02 51 00		//brightness
            		39 01 00 00 00 00 02 53 00 //0C		//PWM output enable,dimming function on
            		39 01 00 00 00 00 02 55 01
            		39 01 00 00 00 00 02 5E 1F
            		39 01 00 00 00 00 02 35 00		//TE enable
            		39 01 00 00 00 00 05 2A 00 00 05 9F             //colume for cmd mode
					//29 01 00 00 00 00 14 c8 01 00 00 00 00 d9 00 00 00 00 00 af 00 00 00 00 00 fc 00 //digital gamma
					29 01 00 00 00 00 14 c8 01 00 00 00 00 cf 00 00 00 00 00 ac 00 00 00 00 00 fc 00 //digital gamma
            		//29 01 00 00 00 00 02 B0 03		//lock,remove it for CE

					//29 01 00 00 00 00 0f C4 70 00 00 33 33 33 33 33 33 33 33 01 08 01 //open EQ for noise
					
					29 01 00 00 00 00 0A f4 fb ff 85 85 7d 01 19 19 00 //set VCOM as default

            		39 01 00 00 05 00 02 29 00		
            		39 01 00 00 10 00 02 11 00];
		qcom,mdss-dsi-off-command = [39 01 00 00 02 00 02 28 00
			     29 01 00 00 00 00 0A f4 b3 ff 85 85 7d 01 19 19 00 //pull down VCOM
				 39 01 00 00 a0 00 02 10 00
				 29 01 00 00 0a 00 02 B1 01 //deep standby
				 ];
		//temp for CE
		#if 0
		qcom,mdss-dsi-ce-off-command = [
					29 01 00 00 00 00 02 ca 80
					];
		qcom,mdss-dsi-ce-low-command = [
					29 01 00 00 00 00 02 ca 80
					];
		qcom,mdss-dsi-ce-mid-command = [
					29 01 00 00 00 00 3a 
					            ca 81 96 92 9b 75 9b 9b 20 20
								80 fe 00 00 00 00 00 00 00 0a
								4a 37 a0 55 f8 0c 0c 20 10 3f
								3f 10 10 3f 3f 3f 3f 00 ff ff
								00 00 00 00 00 00 00 ff ff
								00 00 00 00 00 00 00 ff ff
					];
		qcom,mdss-dsi-ce-high-command = [
					29 01 00 00 00 00 3a 
					            ca 81 9f 98 9b 40 b4 be 20 20
								80 fe 00 00 00 00 00 00 00 0a 
								4a 37 a0 55 f8 0c 0c 20 10 3f 
								3f 10 10 3f 3f 3f 3f 00 ff ff 
								00 00 00 00 00 00 00 ff ff 
								00 00 00 00 00 00 00 ff ff
					];
		#endif
		
		#if 1
		qcom,mdss-dsi-ce-off-command = [
					29 01 00 00 00 00 02 ca 80
					];
		qcom,mdss-dsi-ce-low-command = [
					29 01 00 00 00 00 02 ca 80
					];
		/*qcom,mdss-dsi-ce-mid-command = [
					29 01 00 00 00 00 3a 
					            ca 81 dc e0 dc f0 dc f0 08 3f
								14 8a 00 00 00 00 00 00 00 0a
								4a 37 80 55 c8 0c 0c 0c 08 0c
								08 10 10 3f 3f 3f 3f 00 ff ff
								00 00 00 00 00 00 00 ff ff
								00 00 00 00 00 00 00 ff ff
					];
		qcom,mdss-dsi-ce-high-command = [
					29 01 00 00 00 00 3a 
					            ca 81 dc f0 dc f0 dc f0 0c 3f
								14 8a 00 00 19 19 00 00 ef 0a 
								4a 37 80 55 c8 0c 0c 0c 08 0c 
								08 10 10 3f 3f 3f 3f 00 ff ff 
								00 00 00 00 00 00 00 ff ff 
								00 00 00 00 00 00 00 ff ff
					];*/
	    qcom,mdss-dsi-ce-mid-command = [
					29 01 00 00 00 00 25 
					            CA 81 90 A4 C6 B7 B6 Ad 0C 20
					            80 FF 00 00 00 00 00 00 00 0A
					            4A 37 A0 55 F8 0C 0C 20 10 3F
					            3F 10 10 3F 3F 3F 3F
					];
		qcom,mdss-dsi-ce-high-command = [
					29 01 00 00 00 00 25 
					            CA 81 a0 b4 F6 F7 F6 Ed 15 3F
					            80 FF 00 00 00 00 00 00 00 0A
					            4A 37 A0 55 F8 0C 0C 20 10 3F
					            3F 10 10 3F 3F 3F 3F
					];
		#endif
		
		qcom,mdss-dsi-on-command-state = "dsi_lp_mode";
		qcom,mdss-dsi-off-command-state = "dsi_hs_mode";
		qcom,mdss-dsi-ce-command-state = "dsi_hs_mode";
		qcom,mdss-dsi-h-sync-pulse = <0>;
		//qcom,mdss-dsi-traffic-mode = "burst_mode";
		qcom,mdss-dsi-traffic-mode = "non_burst_sync_event";
		qcom,mdss-dsi-bllp-eof-power-mode;
		qcom,mdss-dsi-bllp-power-mode;		
		qcom,mdss-dsi-lane-0-state;
		qcom,mdss-dsi-lane-1-state;
		qcom,mdss-dsi-lane-2-state;
		qcom,mdss-dsi-lane-3-state;
		//qcom,cmd-sync-wait-broadcast;
		//qcom,mdss-dsi-panel-timings = [D5 32 22 00 60 5C 2E 3E 29 03 04 00];
		qcom,mdss-dsi-panel-timings = [F0 32 28 00 60 96 37 44 29 03 04 00]; //ok
		//qcom,mdss-dsi-panel-timings = [D5 32 22 00 60 64 26 3A 29 03 04 00]; //for mipi test failed
		qcom,mdss-dsi-t-clk-post = <0x03>;//<0x04>;
		qcom,mdss-dsi-t-clk-pre = <0x2c>;//<0x1b>;
		qcom,mdss-dsi-bl-min-level = <1>;
		qcom,mdss-dsi-bl-max-level = <255>;
		qcom,mdss-dsi-dma-trigger = "trigger_sw";
		qcom,mdss-dsi-mdp-trigger = "none";
		qcom,mdss-dsi-bl-pmic-control-type = "bl_ctrl_dcs";
		qcom,mdss-dsi-reset-sequence = <1 2>, <0 10>, <1 20>;//120
		qcom,mdss-pan-physical-width-dimension = <68>;
		qcom,mdss-pan-physical-height-dimension = <121>;
	};
};
